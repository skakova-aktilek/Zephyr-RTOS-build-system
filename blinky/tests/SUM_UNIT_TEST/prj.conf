## CMakeLists.txt
```
cmake_minimum_required(VERSION 3.20.0)

find_package(Zephyr REQUIRED HINTS $ENV{ZEPHYR_BASE})
project(sum_unit_test)

target_sources(app PRIVATE src/sum_test.c ../../sum_log/sum_log.c)
target_include_directories(app PRIVATE ../../sum_log)
```

## Kconfig
```
mainmenu "Sum unit tests"

rsource "../../Kconfig"
```

## prj.conf
```kconfig
CONFIG_ZTEST=y
CONFIG_ZTEST_ASSERT_VERBOSE=2
CONFIG_LOG=y
CONFIG_LOG_DEFAULT_LEVEL=3
CONFIG_LOG_MODE_IMMEDIATE=y
CONFIG_SUM_LOG=y
```

## boards/nrf7002dk_nrf5340_cpuapp_ns.overlay
```dts
/* Reuse the application's bootable flash layout for optional hardware tests. */
#include "../../../boards/nrf7002dk_nrf5340_cpuapp_ns.overlay"
```

## src/sum_test.c
```c
#include <zephyr/ztest.h>
#include "sum_log.h"

ZTEST(sum_log_test_suite, test_sum_log_basic)
{
	zassert_equal(sum_log(3, 5), 8, "3 + 5 should equal 8");
	zassert_equal(sum_log(5, 3), 8, "5 + 3 should equal 8");
}

ZTEST(sum_log_test_suite, test_sum_log_negative)
{
	zassert_equal(sum_log(-3, -5), -8, "Two negatives should sum to -8");
	zassert_equal(sum_log(-3, 5), 2, "Mixed signs should sum to 2");
	zassert_equal(sum_log(3, -5), -2, "Mixed signs should sum to -2");
}

ZTEST(sum_log_test_suite, test_sum_log_zero)
{
	zassert_equal(sum_log(0, 0), 0, "0 + 0 should equal 0");
	zassert_equal(sum_log(7, 0), 7, "Adding zero should preserve the value");
	zassert_equal(sum_log(0, -7), -7, "Zero plus a negative should preserve it");
}

ZTEST_SUITE(sum_log_test_suite, NULL, NULL, NULL, NULL, NULL);
```
