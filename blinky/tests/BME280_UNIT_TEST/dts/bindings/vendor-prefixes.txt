## blinky/tests/BME280_UNIT_TEST/testcase.yaml
```yaml
tests:
  bme280.raw:
    platform_allow:
      - qemu_cortex_m3
    integration_platforms:
      - qemu_cortex_m3
    tags:
      - i2c
      - unit
    harness: ztest
```

## blinky/tests/SUM_UNIT_TEST/testcase.yaml
```yaml
tests:
  sum_log.test:
    platform_allow:
      - qemu_cortex_m3
      - nrf7002dk/nrf5340/cpuapp/ns
    integration_platforms:
      - qemu_cortex_m3
    tags:
      - sum_log
      - unit
    harness: ztest
```
